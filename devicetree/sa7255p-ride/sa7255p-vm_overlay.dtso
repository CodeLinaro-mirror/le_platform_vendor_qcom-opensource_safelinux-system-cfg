// SPDX-License-Identifier: BSD-3-Clause
/*
 * Copyright (c) Qualcomm Technologies, Inc. and/or its subsidiaries.
 */


/dts-v1/;
/plugin/;

#include "sa7255p_overlay.dtso"
#include "sa7255p-vms-hab.dtsi"
#include "sa7255p-vms.dtsi"
#include "sa7255p-vms-lv.dtsi"

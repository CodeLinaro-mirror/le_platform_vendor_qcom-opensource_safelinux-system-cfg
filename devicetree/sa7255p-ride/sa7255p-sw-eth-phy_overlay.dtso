// SPDX-License-Identifier: BSD-3-Clause
/*
* Copyright (c) Qualcomm Technologies, Inc. and/or its subsidiaries.
*/

#include "sa7255p_overlay.dtso"

&{/} {
	model = "Qualcomm Technologies, Inc. SA7255P Ride Switch Ethernet PHY";
	qcom,board-id = <0x01030019 1>;
};

&ethernet0 {
	status = "okay";

	mdio {
		status = "disabled";
	};

	fixed-link {
		status = "okay";
		speed = <2500>;
		full-duplex;
	};
};


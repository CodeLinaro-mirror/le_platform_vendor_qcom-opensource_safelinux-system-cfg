// SPDX-License-Identifier: BSD-3-Clause
/*
 * Copyright (c) Qualcomm Technologies, Inc. and/or its subsidiaries.
 */

#include "sa7255p_overlay.dtso"
#include "sa7255p-vms-hab.dtsi"
#include "sa7255p-vms.dtsi"
#include "sa7255p-vms-lv.dtsi"

&{/} {
	model = "Qualcomm Technologies, Inc. SA7255P ADP STAR";
	compatible = "qcom,sa7255p-star","qcom,sa7255p";
	qcom,msm-id = <606 0x10000>;
	qcom,board-id = <0x10019 0>;
};

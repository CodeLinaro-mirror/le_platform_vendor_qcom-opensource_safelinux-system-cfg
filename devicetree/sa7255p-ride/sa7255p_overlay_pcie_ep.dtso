// SPDX-License-Identifier: BSD-3-Clause
/*
 * Copyright (c) Qualcomm Technologies, Inc. and/or its subsidiaries.
 */

#include "sa7255p_overlay.dtso"

&{/} {
	model = "Qualcomm Technologies, Inc. SA7255P Ride PCIe EP Mode";
	qcom,board-id = <0x3010019 0>;
};
// SPDX-License-Identifier: BSD-3-Clause
/*
 * Copyright (c) Qualcomm Technologies, Inc. and/or its subsidiaries.
 */

#include "sa7255p_overlay_pcie_ep.dtso"
#include "sa7255p-vms-hab.dtsi"
#include "sa7255p-vms.dtsi"
#include "sa7255p-vms-lv.dtsi"

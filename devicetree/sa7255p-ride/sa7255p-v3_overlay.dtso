// SPDX-License-Identifier: BSD-3-Clause
/*
 * Copyright (c) Qualcomm Technologies, Inc. and/or its subsidiaries.
 */

#include "sa7255p_overlay.dtso"

&{/} {
	model = "Qualcomm Technologies, Inc. SA7255P Ride V3";
	qcom,board-id = <0x01020019 1>;
};

&ethernet0 {
	phy-mode = "2500base-x";
	qcom-disable-sph;
	iommus = <&apps_smmu 0x120 0x7>;
};

&sgmii_phy0 {
	compatible = "ethernet-phy-id31c3.1c33";
};

// SPDX-License-Identifier: BSD-3-Clause
/*
 * Copyright (c) 2024 Qualcomm Innovation Center, Inc. All rights reserved.
 */

/dts-v1/;

#include "sa7255p.dtsi"
/ {
	model = "Qualcomm SA7255P Ride";
	compatible = "qcom,sa7255p";
};


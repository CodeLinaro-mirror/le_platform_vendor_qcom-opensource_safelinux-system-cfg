// SPDX-License-Identifier: BSD-3-Clause
/*
 * Copyright (c) 2024 Qualcomm Innovation Center, Inc. All rights reserved.
 */

/dts-v1/;
/plugin/;

#include "sa8255p_overlay.dtsi"

&{/} {
	model = "Qualcomm Technologies, Inc. SA8650P Ride";
	qcom,msm-id = <533 0x10000>, <533 0x20000>;
};

&ethernet0 {
	iommus = <&apps_smmu 0x120 0x7>;
};

&ethernet1 {
	iommus = <&apps_smmu 0x140 0x7>;
};
// SPDX-License-Identifier: BSD-3-Clause
/*
 * Copyright (c) Qualcomm Technologies, Inc. and/or its subsidiaries.
 */
/dts-v1/;
/plugin/;

/ {
	compatible = "qcom,sa8255p-ride";
};

&non_ecc_heap_mem {
	reg = <0x2 0x43000000 0x1 0xA8D00000>;
};

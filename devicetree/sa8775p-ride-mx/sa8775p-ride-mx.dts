// SPDX-License-Identifier: BSD-3-Clause
/*
 * Copyright (c) 2023-2025 Qualcomm Innovation Center, Inc. All rights reserved.
 * Copyright (c) 2023, Linaro Limited
 */

#include "sa8775p-ride-mx_common.dtsi"

/ {
	model = "Qualcomm Technologies, Inc. SA8775P Ride MX";
	qcom,msm-id = <534 0x20000>;
};


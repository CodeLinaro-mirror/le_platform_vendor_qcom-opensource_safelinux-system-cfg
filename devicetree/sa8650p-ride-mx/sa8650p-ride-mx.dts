// SPDX-License-Identifier: BSD-3-Clause
/*
 * Copyright (c) 2025 Qualcomm Innovation Center, Inc. All rights reserved.
 */

#include "sa8775p-ride-mx_common.dtsi"

/ {
	model = "Qualcomm Technologies, Inc. SA8650P Ride MX";
	qcom,msm-id = <533 0x20000>;
};


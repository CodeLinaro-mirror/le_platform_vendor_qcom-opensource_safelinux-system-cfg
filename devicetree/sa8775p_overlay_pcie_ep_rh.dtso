// SPDX-License-Identifier: BSD-3-Clause
/*
 * Copyright (c) 2024 Qualcomm Innovation Center, Inc. All rights reserved.
 */

#include "sa8775p_overlay_rh.dtso"

&{/} {
	model = "Qualcomm Technologies, Inc. SA8775P Star SIP with PCIE configured in EP Mode";
	compatible = "qcom,sa8775p-ride", "qcom,sa8775p";
	qcom,board-id = <0x3010025 3>;
};

&pcie1 {
	status = "disabled";
};

&pcie1_ep {
	status = "okay";
};


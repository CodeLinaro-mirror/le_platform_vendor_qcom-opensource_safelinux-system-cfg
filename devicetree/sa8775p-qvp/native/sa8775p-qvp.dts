// SPDX-License-Identifier: BSD-3-Clause
/*
 * Copyright (c) 2025 Qualcomm Innovation Center, Inc. All rights reserved.
 */

/dts-v1/;
#include "sa8775p-qvp.dtsi"

/ {
	model = "Qualcomm Technologies, Inc. SA8775P Virtual Platform";
	compatible = "qcom,sa8775p";
	qcom,msm-id = <534 0x20000>;

	/delete-node/virtio_mmio@1d8c000;
	/delete-node/virtio_mmio@1d90000;
};

// SPDX-License-Identifier: BSD-3-Clause
/*
 * Copyright (c) 2025 Qualcomm Innovation Center, Inc. All rights reserved.
 */

/dts-v1/;
#include "sa8775p-qvp.dtsi"

/ {
	model = "Qualcomm Technologies, Inc. SA8775P Virtual Platform";
	compatible = "qcom,sa8775p";
	qcom,msm-id = <534 0x20000>;

	chosen {
		bootargs = "rw root=/dev/vda earlyprintk=serial,ttyAMA0 console=ttyAMA0 \
		firmware_class.path=/firmware rdinit=/sbin/early-ramdisk-init early-ramdisk.mode=0";
		stdout-path = "/pl011@40000000";
		linux,initrd-start = <0xbd151000>;
		linux,initrd-end =  <0xbef00000>;
		kaslr-seed = <0x0 0x0>;
	};
};

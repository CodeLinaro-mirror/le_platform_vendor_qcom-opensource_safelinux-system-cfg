// SPDX-License-Identifier: BSD-3-Clause
/*
 * Copyright (c) Qualcomm Technologies, Inc. and/or its subsidiaries.
 */

/dts-v1/;
/plugin/;

#include "sa8255p_overlay.dtsi"

&{/} {
	model = "Qualcomm Technologies, Inc. SA8255P Ride";
	qcom,msm-id = <532 0x10000>, <532 0x20000>;
};

&ethernet0 {
	iommus = <&apps_smmu 0x120 0x7>;
};

&ethernet1 {
	iommus = <&apps_smmu 0x140 0x7>;
};

&scmi46 {
	status = "okay";
};

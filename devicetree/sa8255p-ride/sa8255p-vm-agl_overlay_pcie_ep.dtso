// SPDX-License-Identifier: BSD-3-Clause
/*
 * Copyright (c) Qualcomm Technologies, Inc. and/or its subsidiaries.
 */

/dts-v1/;
/plugin/;

#include "sa8255p-vm_overlay_pcie_ep.dtso"
#include "sa8775p-vms-trout.dtsi"
#include "sa8775p-vms-lv-agl.dtsi"

&{/} {
	model = "Qualcomm Technologies, Inc. SA8255P Star SIP with PCIE configured in EP Mode QCVirtIO";
};

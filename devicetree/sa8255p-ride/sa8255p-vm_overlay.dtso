// SPDX-License-Identifier: BSD-3-Clause
/*
 * Copyright (c) Qualcomm Technologies, Inc. and/or its subsidiaries.
 */


/dts-v1/;
/plugin/;

#include "sa8255p_overlay.dtso"
#include "sa8775p-vms.dtsi"
#include "sa8775p-vms-lv.dtsi"
#include "sa8255p-vms_overlay.dtsi"

// SPDX-License-Identifier: BSD-3-Clause
/*
 * Copyright (c) Qualcomm Technologies, Inc. and/or its subsidiaries.
 */
/dts-v1/;
/plugin/;

/ {
	compatible = "qcom,sa8255p-ride";
};

// Keep the original attributes of sa8255p_overlay.dtsi non-ecc heap unchanged.

&{/reserved-memory} {
	mdlc: mdlc@91300000 {
		no-map;
		reg = <0x0 0x91300000 0x0 0x10000>;
	};
};


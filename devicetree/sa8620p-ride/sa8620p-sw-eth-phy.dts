// SPDX-License-Identifier: BSD-3-Clause
/*
 * Copyright (c) 2025 Qualcomm Innovation Center, Inc. All rights reserved.
 */

#include "sa8620p_common.dtsi"

/ {
	model = "Qualcomm Technologies, Inc. SA8620P Ride Switch Ethernet PHY";
	qcom,board-id = <0x01030019 1>;
};


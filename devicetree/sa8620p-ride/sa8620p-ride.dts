// SPDX-License-Identifier: BSD-3-Clause
/*
 * Copyright (c) 2024 Qualcomm Innovation Center, Inc. All rights reserved.
 */

#include "sa8620p_common.dtsi"

/ {
	model = "Qualcomm Technologies, Inc. SA8620P Ride";
	qcom,board-id = <0x10019 0>, <0x1010019 1>;
};


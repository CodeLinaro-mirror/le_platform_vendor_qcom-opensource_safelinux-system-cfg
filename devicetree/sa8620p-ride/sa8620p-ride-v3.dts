// SPDX-License-Identifier: BSD-3-Clause
/*
 * Copyright (c) Qualcomm Technologies, Inc. and/or its subsidiaries.
 */

#include "sa8620p_common.dtsi"

/ {
	model = "Qualcomm Technologies, Inc. SA8620P Ride V3";
	qcom,board-id = <0x01020019 1>;
};

&ethernet0 {
	phy-mode = "2500base-x";
	qcom-disable-sph;
};

&sgmii_phy0 {
	compatible = "ethernet-phy-id31c3.1c33";
};


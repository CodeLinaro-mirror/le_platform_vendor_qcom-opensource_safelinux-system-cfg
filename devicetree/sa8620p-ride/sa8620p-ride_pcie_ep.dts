// SPDX-License-Identifier: BSD-3-Clause
/*
 * Copyright (c) Qualcomm Technologies, Inc. and/or its subsidiaries.
 */

#include "sa8620p_common.dtsi"

/ {
	model = "Qualcomm Technologies, Inc. SA8620P Ride PCIe EP Mode";
	qcom,board-id = <0x3010019 3>;
};

&pcie1 {
	status = "disabled";
};

&pcie1_ep {
	status = "okay";
};

